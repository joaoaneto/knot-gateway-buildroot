## package/access-control-proxy/Config.in
```kconfig
config BR2_PACKAGE_ACCESS_CONTROL_PROXY
	bool "access-control-proxy"
	depends on BR2_PACKAGE_NODEJS
	help
	  TODO
```

## package/access-control-service/Config.in
```kconfig
config BR2_PACKAGE_ACCESS_CONTROL_SERVICE
	bool "access-control-service"
	depends on BR2_PACKAGE_NODEJS
	help
	  TODO
```

## package/jaeger/Config.in
```kconfig
config BR2_PACKAGE_JAEGER
	bool "jaeger"
	depends on BR2_PACKAGE_HOST_GO_ARCH_SUPPORTS
	depends on BR2_PACKAGE_HOST_GO_CGO_LINKING_SUPPORTS
	help
      Jaeger, inspired by Dapper and OpenZipkin, is a distributed
      tracing system released as open source by Uber Technologies
      and written in Go. It is used for monitoring and
      troubleshooting microservices-based distributed systems.

	  https://github.com/jaegertracing/jaeger
```

## package/knot-babeltower/Config.in
```kconfig
config BR2_PACKAGE_KNOT_BABELTOWER
	bool "babeltower"
    depends on BR2_PACKAGE_HOST_GO_ARCH_SUPPORTS
    depends on BR2_PACKAGE_HOST_GO_CGO_LINKING_SUPPORTS
    depends on BR2_PACKAGE_RABBITMQ
	help
		The babeltower aims orchestrate the communication with the fog
		services, acting both as a proxy and a protocol translator since
		the internal operations can be made to services that support
		different application protocols. The devices that support IP
		connectivity can connect directly to it.

	  https://github.com/CESARBR/knot-babeltower
```

## package/knot-connector/Config.in
```kconfig
config BR2_PACKAGE_KNOT_CONNECTOR
	bool "knot-connector"
	depends on BR2_PACKAGE_NODEJS
	help
	  TODO
```

## package/meshblu/Config.in
```kconfig
menuconfig BR2_PACKAGE_MESHBLU
	bool "Meshblu"
	select BR2_PACKAGE_MONGODB
	select BR2_PACKAGE_REDIS
	select BR2_PACKAGE_MESHBLU_DISPATCHER

if BR2_PACKAGE_MESHBLU
	source "package/meshblu/meshblu-dispatcher/Config.in"

	source "package/meshblu/meshblu-adapter-http/Config.in"

	source "package/meshblu/meshblu-adapter-websocket/Config.in"

endif
```

## package/meshblu/meshblu-adapter-http/Config.in
```kconfig
config BR2_PACKAGE_MESHBLU_ADAPTER_HTTP
	bool "meshblu-adapter-http"
	depends on BR2_PACKAGE_MESHBLU_DISPATCHER
	help
	  A Protocol Adapter translates between HTTP and Meshblu
	  Core.
```

## package/meshblu/meshblu-adapter-websocket/Config.in
```kconfig
config BR2_PACKAGE_MESHBLU_ADAPTER_WEBSOCKET
	bool "meshblu-adapter-websocket"
	depends on BR2_PACKAGE_MESHBLU_DISPATCHER
	help
	  A Protocol Adapter translates between HTTP and Meshblu
	  Core.
```

## package/meshblu/meshblu-dispatcher/Config.in
```kconfig
config BR2_PACKAGE_MESHBLU_DISPATCHER
	bool "meshblu-dispatcher"
	depends on BR2_PACKAGE_MESHBLU
	help
	  Meshblu core message broker
```

## package/meshblu/meshblu-worker-webhook/Config.in
```kconfig
config BR2_PACKAGE_MESHBLU_WORKER_WEBHOOK
	bool "meshblu-worker-webhook"
	depends on BR2_PACKAGE_MESHBLU_DISPATCHER
	help
	  Wireless Network Interface Daemon for Low-Power Wireless SoCs
```
